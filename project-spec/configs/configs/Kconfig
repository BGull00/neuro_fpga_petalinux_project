## project-spec/configs/configs/Kconfig
```kconfig
mainmenu "PetaLinux System Configuration"
config SUBSYSTEM_TYPE_LINUX
        bool
        default y
        select SYSTEM_ZYNQ

config SYSTEM_ZYNQ
        bool "ZYNQ Configuration"
        help
          ZYNQ Configuration for petalinux project.
          All these config options will be in /home/bryson/Documents/Xilinx_Projects/pynq_dma_test/petalinux/project-spec/configs/config

config SUBSYSTEM_DISTRO_PETALINUX
        bool
        default y
        help

source /home/bryson/Documents/Xilinx_Projects/pynq_dma_test/petalinux/project-spec/configs/configs/Kconfig.main
```

## project-spec/configs/rootfsconfigs/Kconfig.user
```kconfig
menu "user packages " 
config dmaproxy  
	 bool "dmaproxy"
	 help
	
config dmaproxy-startup  
	 bool "dmaproxy-startup"
	 help
	
config dmaproxy-test  
	 bool "dmaproxy-test"
	 help
	
config gpio-demo  
	 bool "gpio-demo"
	 help
	
config peekpoke  
	 bool "peekpoke"
	 help
	
config pynq-dma-test  
	 bool "pynq-dma-test"
	 help
	
config xvc-driver  
	 bool "xvc-driver"
	 help
	
config xvcserver  
	 bool "xvcserver"
	 help
	
endmenu
```
