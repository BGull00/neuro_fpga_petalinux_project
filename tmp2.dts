/dts-v1/;

/ {

	fragment@0 {
		target = <0xffffffff>;

		__overlay__ {
			firmware-name = "pynq-dma-test.bin";
			pid = <0x00>;
			uid = <0x00>;

			clocking0 {
				#clock-cells = <0x00>;
				assigned-clock-rates = <0x5f5e100>;
				assigned-clocks = <0xffffffff 0x0f>;
				clock-output-names = "fabric_clk";
				clocks = <0xffffffff 0x0f>;
				compatible = "xlnx,fclk";
				phandle = <0x02>;
			};
		};
	};

	fragment@1 {
		target = <0xffffffff>;

		__overlay__ {
			#address-cells = <0x01>;
			#size-cells = <0x01>;

			afi0@f8008000 {
				#address-cells = <0x01>;
				#size-cells = <0x00>;
				compatible = "xlnx,afi-fpga";
				reg = <0xf8008000 0x1000>;
				xlnx,afi-width = <0x00>;
				phandle = <0x03>;
			};

			dma@40400000 {
				#dma-cells = <0x01>;
				clock-names = "m_axi_mm2s_aclk\0m_axi_s2mm_aclk\0s_axi_lite_aclk";
				clocks = <0xffffffff 0x0f 0xffffffff 0x0f 0xffffffff 0x0f>;
				compatible = "xlnx,axi-dma-7.1\0xlnx,axi-dma-1.00.a";
				interrupt-names = "mm2s_introut\0s2mm_introut";
				interrupt-parent = <0xffffffff>;
				interrupts = <0x00 0x1d 0x04 0x00 0x1e 0x04>;
				reg = <0x40400000 0x10000>;
				xlnx,addrwidth = <0x20>;
				xlnx,sg-length-width = <0x0e>;
				phandle = <0x01>;

				dma-channel@40400000 {
					compatible = "xlnx,axi-dma-mm2s-channel";
					dma-channels = <0x01>;
					interrupts = <0x00 0x1d 0x04>;
					xlnx,datawidth = <0x20>;
					xlnx,device-id = <0x00>;
				};

				dma-channel@40400030 {
					compatible = "xlnx,axi-dma-s2mm-channel";
					dma-channels = <0x01>;
					interrupts = <0x00 0x1e 0x04>;
					xlnx,datawidth = <0x20>;
					xlnx,device-id = <0x00>;
				};
			};
		};
	};

	fragment@2 {
		target = <0xffffffff>;

		__overlay__ {

			dmaproxy {
				compatible = "xlnx,dmaproxy";
				dmas = <0x01 0x00 0x01 0x01>;
				dma-names = "dmaproxy_tx\0dmaproxy_rx";
			};
		};
	};

	__symbols__ {
		clocking0 = "/fragment@0/__overlay__/clocking0";
		afi0 = "/fragment@1/__overlay__/afi0@f8008000";
		axi_dma_0 = "/fragment@1/__overlay__/dma@40400000";
	};

	__fixups__ {
		fpga_full = "/fragment@0:target:0";
		clkc = "/fragment@0/__overlay__/clocking0:assigned-clocks:0\0/fragment@0/__overlay__/clocking0:clocks:0\0/fragment@1/__overlay__/dma@40400000:clocks:0\0/fragment@1/__overlay__/dma@40400000:clocks:8\0/fragment@1/__overlay__/dma@40400000:clocks:16";
		amba = "/fragment@1:target:0\0/fragment@2:target:0";
		intc = "/fragment@1/__overlay__/dma@40400000:interrupt-parent:0";
	};

	__local_fixups__ {

		fragment@2 {

			__overlay__ {

				dmaproxy {
					dmas = <0x00 0x08>;
				};
			};
		};
	};
};
